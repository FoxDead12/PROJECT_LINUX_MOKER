## kernel/moker/Kconfig
```kconfig
menu "MOKER framework"

  config MOKER_FRAMEWORK
  bool "My Own KERnel Framework"
  default y

  config MOKER_TRACING
  bool "MOKER tracing"
  default y
  depends on MOKER_FRAMEWORK

  config MOKER_SCHED_RM_POLICY
  bool "MOKER scheduling policy: Rate Monotonic"
  default y
  depends on MOKER_FRAMEWORK

    config MOKER_MUTEX_PIP
    bool "MOKER mutex policy: PIP"
    default y
    depends on MOKER_SCHED_RM_POLICY

endmenu
```
